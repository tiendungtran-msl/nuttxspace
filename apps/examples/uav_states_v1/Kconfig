## apps/examples/uav_states_v1/Kconfig
```kconfig
#
# For a description of the syntax of this configuration file,
# see the file kconfig-language.txt in the NuttX tools repository.
#

config EXAMPLES_UAV_STATES_V1
    tristate "UAV States example version 1"
    default n
    ---help---
        Enable the UAV States example application

if EXAMPLES_UAV_STATES_V1

config EXAMPLES_UAV_STATES_V1_PROGNAME
    string "Program name"
    default "uav_states_v1"
    ---help---
        This is the name of the program that will be used when the NSH ELF
        program is installed.

config EXAMPLES_UAV_STATES_V1_PRIORITY
    int "UAV States task priority"
    default 100
    ---help---
        Priority of the UAV States task.

config EXAMPLES_UAV_STATES_V1_STACKSIZE
    int "UAV States stack size"
    default DEFAULT_TASK_STACKSIZE
    ---help---
        Stack size allocated for the UAV States task.

endif
```

## apps/uav/calib_app/Kconfig
```kconfig
#
# apps/uav/calib_app/Kconfig
#
# Sensor Calibration Application Configuration
#

config UAV_CALIB
	tristate "UAV Sensor Calibration"
	default n
	depends on UAV
	---help---
		Interactive sensor calibration application.
		Cung cấp các lệnh calibration cho:
		- Gyroscope bias (giữ yên, tính trung bình)
		- Accelerometer bias + scale (6-position)
		- Magnetometer hard-iron offset (sphere-fit)

		Sử dụng: calib <gyro|accel|mag|status|reset>

if UAV_CALIB

config UAV_CALIB_PRIORITY
	int "Calibration task priority"
	default 100
	---help---
		Priority cho calibration task.
		Thấp hơn sensor tasks vì chỉ chạy khi cần.

config UAV_CALIB_STACKSIZE
	int "Calibration task stack size"
	default 4096
	---help---
		Stack size cho calibration task.

config UAV_CALIB_GYRO_SAMPLES
	int "Number of gyro calibration samples"
	default 5000
	---help---
		Số mẫu thu thập khi calibrate gyro.
		Mặc định 5000 mẫu (~5 giây ở 1kHz).

config UAV_CALIB_ACCEL_SAMPLES
	int "Number of accel samples per position"
	default 1000
	---help---
		Số mẫu thu thập cho mỗi vị trí khi calibrate accel.

config UAV_CALIB_MAG_SAMPLES
	int "Number of mag calibration samples"
	default 2000
	---help---
		Số mẫu thu thập khi calibrate magnetometer.

endif # UAV_CALIB
```

## apps/uav/drivers/Kconfig
```kconfig
#
# apps/uav/drivers/Kconfig
#
# UAV Drivers Configuration
#
# MỤC ĐÍCH:
# - Menu cấu hình cho tất cả drivers
# - Chọn driver cho từng loại sensor
#

menu "UAV Drivers"

config UAV_DRIVERS
	bool "Enable UAV hardware drivers"
	default n
	---help---
		Enable hardware drivers for UAV sensors.

if UAV_DRIVERS

comment "IMU Drivers"

config UAV_DRIVER_ICM42688P
	bool "InvenSense ICM-42688P"
	default y
	---help---
		Enable driver for ICM-42688P 6-axis IMU.
		SPI interface, up to 32 kHz ODR.

config UAV_DRIVER_MPU6050
	bool "InvenSense MPU-6050"
	default n
	---help---
		Enable driver for MPU-6050 6-axis IMU.
		I2C interface.

comment "Magnetometer Drivers"

config UAV_DRIVER_RM3100
	bool "PNI RM3100"
	default n
	---help---
		Enable driver for RM3100 magnetometer.
		SPI/I2C interface, high resolution.

config UAV_DRIVER_BMM150
	bool "Bosch BMM150"
	default n
	---help---
		Enable driver for BMM150 3-axis magnetometer.
		I2C interface, Bosch compensation algorithm.
		Pins: PB6 (SCL), PB7 (SDA).

config UAV_DRIVER_HMC5883
	bool "Honeywell HMC5883L"
	default n
	---help---
		Enable driver for HMC5883L magnetometer.
		I2C interface.

comment "Barometer Drivers"

config UAV_DRIVER_MS5611
	bool "TE MS5611"
	default n
	---help---
		Enable driver for MS5611 barometer.
		SPI/I2C interface, high resolution.

config UAV_DRIVER_BMP280
	bool "Bosch BMP280"
	default n
	---help---
		Enable driver for BMP280 barometer.
		SPI/I2C interface.

comment "GPS Drivers"

config UAV_DRIVER_UBLOX
	bool "u-blox GPS"
	default n
	---help---
		Enable driver for u-blox GPS receivers.
		UART interface, UBX protocol.

endif # UAV_DRIVERS

# GPS driver has its own enable - source outside of UAV_DRIVERS
source "/home/msi-leibniz/nuttxspace/apps/uav/drivers/gps/Kconfig"

endmenu
```

## apps/uav/eskf_app/Kconfig
```kconfig
#
# apps/uav/eskf_app/Kconfig
#
# ESKF Estimator Application Configuration
#
# MỤC ĐÍCH:
# - Cấu hình ESKF estimator qua menuconfig
# - Task priority, stack size
#

config UAV_ESKF
	tristate "UAV ESKF Attitude Estimator"
	default n
	depends on UAV_UORB
	---help---
		Error-State Kalman Filter (ESKF) cho ước lượng tư thế.
		Sử dụng chủ yếu dữ liệu IMU (9-state, không cần GPS).

		State vector 9 chiều:
		  - delta_theta (3): Sai số tư thế
		  - delta_bg (3): Sai số gyro bias
		  - delta_ba (3): Sai số accel bias

		Prediction: Gyroscope propagation.
		Update: Accelerometer gravity observation.

		Dựa trên: J. Sola, "Quaternion kinematics for the
		error-state Kalman filter"

		Lệnh: eskf start | stop | status

if UAV_ESKF

config UAV_ESKF_PRIORITY
	int "ESKF task priority"
	default 240
	---help---
		Priority của ESKF task.
		Nên thấp hơn sensors_app (250) nhưng cao hơn state_app.

config UAV_ESKF_STACKSIZE
	int "ESKF task stack size"
	default 8192
	---help---
		Stack size cho ESKF task.
		Cần đủ cho ma trận 9x9 covariance operations.

endif # UAV_ESKF
```

## apps/uav/estimator_app/Kconfig
```kconfig
#
# apps/uav/estimator_app/Kconfig
#
# Estimator Application Configuration
#
# MỤC ĐÍCH:
# - Cấu hình estimator_app qua menuconfig
# - Chọn thuật toán estimation (EKF2 / Complementary)
# - Tuning parameters
#

config UAV_ESTIMATOR
	tristate "UAV Estimator Application"
	default n
	depends on UAV_UORB
	---help---
		Enable UAV estimator application.
		Ước lượng tư thế và vị trí từ sensor data.
		Subscribe sensor topics, publish vehicle_attitude và vehicle_local_position.

if UAV_ESTIMATOR

config UAV_ESTIMATOR_PRIORITY
	int "Estimator task priority"
	default 240
	---help---
		Priority của estimator task.
		Thấp hơn sensors_app (250) nhưng cao hơn state_app.

config UAV_ESTIMATOR_STACKSIZE
	int "Estimator task stack size"
	default 8192
	---help---
		Stack size cho estimator task.
		EKF2 cần nhiều stack cho covariance matrix.

choice
	prompt "Estimator algorithm"
	default UAV_ESTIMATOR_EKF2

config UAV_ESTIMATOR_EKF2
	bool "EKF2 (16-state)"
	---help---
		Extended Kalman Filter với 16 state:
		- Quaternion (4)
		- Velocity NED (3)
		- Position NED (3)
		- Gyro bias (3)
		- Accel bias (3)

config UAV_ESTIMATOR_COMPLEMENTARY
	bool "Complementary Filter"
	---help---
		Simple complementary filter cho attitude only.
		Ít tốn CPU hơn EKF2.
		Không ước lượng position.

endchoice

config UAV_ESTIMATOR_MAG_FUSION
	bool "Enable magnetometer fusion"
	default y
	---help---
		Fusion magnetometer để ước lượng yaw.

config UAV_ESTIMATOR_BARO_FUSION
	bool "Enable barometer fusion"
	default y
	---help---
		Fusion barometer để ước lượng altitude.

config UAV_ESTIMATOR_GPS_FUSION
	bool "Enable GPS fusion"
	default y
	---help---
		Fusion GPS để ước lượng position và velocity.

endif # UAV_ESTIMATOR
```

## apps/uav/state_app/Kconfig
```kconfig
#
# apps/uav/state_app/Kconfig
#
# State Application Configuration
#
# MỤC ĐÍCH:
# - Cấu hình state_app qua menuconfig
# - Failsafe timeouts
# - Arming checks
#

config UAV_STATE
	tristate "UAV State Manager"
	default n
	depends on UAV_UORB
	---help---
		Enable UAV state management application.
		Quản lý arming, flight mode, failsafe.

if UAV_STATE

config UAV_STATE_PRIORITY
	int "State manager task priority"
	default 220
	---help---
		Priority của state manager task.
		Thấp hơn sensors/eskf (240+).

config UAV_STATE_STACKSIZE
	int "State manager task stack size"
	default 4096
	---help---
		Stack size cho state manager task.

config UAV_STATE_LOOP_RATE
	int "State manager loop rate (Hz)"
	default 50
	range 10 100
	---help---
		Tần số update state machine.
		50 Hz là đủ cho hầu hết trường hợp.

config UAV_STATE_IMU_TIMEOUT_MS
	int "IMU data timeout (ms)"
	default 500
	range 100 2000
	---help---
		Timeout cho IMU data.
		Failsafe sẽ trigger nếu không nhận được data
		trong khoảng thời gian này.

config UAV_STATE_ATT_TIMEOUT_MS
	int "Attitude estimate timeout (ms)"
	default 500
	range 100 2000
	---help---
		Timeout cho attitude estimate.
		Failsafe sẽ trigger nếu attitude stream mất.

config UAV_STATE_PREFLIGHT_GPS
	bool "Require GPS for arming"
	default n
	---help---
		Yêu cầu GPS fix trước khi arm.
		Disable nếu bay indoor hoặc không có GPS.

config UAV_STATE_PREFLIGHT_MAG
	bool "Require magnetometer for arming"
	default n
	---help---
		Yêu cầu magnetometer calibrated trước khi arm.

endif # UAV_STATE
```
